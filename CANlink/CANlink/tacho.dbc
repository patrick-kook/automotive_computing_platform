VERSION ""

NS_ :

BS_:

BU_: Tacho

VAL_TABLE_ OnOff 1 "on" 0 "off" ;

BO_ 291 thaco: 8 Tacho
 SG_ throttle_percent : 7|32@0+ (0.01,0) [0|0] "" Vector__XXX
 SG_ meter : 39|32@0+ (0.001,0) [0|0] "" Vector__XXX
